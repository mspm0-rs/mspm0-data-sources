# MSPM0G5187 register map
Vendor: Texas Instruments; File version: Revised: 2025-07-22 15:38:34
ARM Device
CPU: CM0 r0p1, little endian, MPU, no FPU, 3 interrupt priority bits
Registers are 32-bit, read-write, reset 0x0 unless marked. A register's access mark holds for its fields unless they carry their own. Offsets are from the block's base; lines under a group give offsets from that group; [hi:lo] are bit positions; {n}, {i} and the like mark numbered series; 'fields as' and 'values as' point back to an identical list; <NAME> marks a mode.

## Memory map
0x00000000 FLASH size 0x20000 — MEM
0x20000000 SYSMEM size 0x8000 — MEM
0x40004000 ADC0 size 0x2000 — PERIPHERALREGION
0x40008000 COMP0 size 0x1F00 — PERIPHERALREGION
0x40030000 VREF size 0x1F00 — PERIPHERALREGION
0x40080000 WWDT0 size 0x1500 — WWDT
0x40082000 WWDT1 size 0x1500 — WWDT
0x40084000 TIMG0 size 0x1F00 — PERIPHERALREGION
0x40094000 LFSS size 0x1600 — PERIPHERALREGION
0x400A0000 GPIOA size 0x1F00 — PERIPHERALREGION
0x400A2000 GPIOB size 0x1F00 — PERIPHERALREGION
0x400AC000 KEYSTORECTL size 0x2000 — PERIPHERALREGION
0x400AF000 SYSCTL size 0x3100 — MEM_MAP
0x400B8000 TIMB0 size 0x1C00 — PERIPHERALREGION
0x400C7000 DEBUGSS size 0x1F00 — DSSM
0x400C9000 EVENTLP size 0x3000 — PERIPHERALREGION
0x400CD000 FLASHCTL size 0x2000 — NVMNW_A1USB
0x40400000 CPUSS size 0x1F00 — CPUSSMMR
0x40424000 WUC size 0x500 — PERIPHERALREGION
0x40428000 IOMUX size 0x2000 — PERIPHERALREGION
0x4042A000 DMA size 0x1F00 — PERIPHERALREGION
0x40440000 CRCP0 size 0x2000 — PERIPHERALREGION
0x40442000 AESADV size 0x1200 — PERIPHERALREGION
0x4047B000 I2S0 size 0x1F00 — PERIPHERALREGION
0x4047F000 USBFS0 size 0x3000 — PERIPHERALREGION
0x4055A000 ADC0_SVT size 0x1000 — PERIPHERALREGIONSVT
0x40860000 TIMA0 size 0x1F00 — PERIPHERALREGION
0x40868000 TIMG6 size 0x1F00 — PERIPHERALREGION
0x4086A000 TIMG7 size 0x1F00 — PERIPHERALREGION
0x408FF000 NPU size 0x3F00 — PERIPHERALREGION
0x40A00000 UC0_UART size 0x1500 — PERIPHERALREGION
0x40A02000 UC1_UART size 0x3500 — PERIPHERALREGION
0x40A20000 UC0_I2CC size 0x21500 — PERIPHERALREGION
0x40A22000 UC1_I2CC size 0x23500 — PERIPHERALREGION
0x40A40000 UC0_I2CT size 0x41500 — PERIPHERALREGION
0x40A42000 UC1_I2CT size 0x43500 — PERIPHERALREGION
0x40A80000 UC0 size 0x81C00 — PERIPHERALREGION
0x40A82000 UC1 size 0x83C00 — PERIPHERALREGION
0x40A9F000 SPG0 size 0xA0C00 — PERIPHERALREGION
0x40B02000 UC3_UART size 0x3500 — PERIPHERALREGION
0x40B60000 UC2_SPI size 0x61200 — PERIPHERALREGION
0x40B62000 UC3_SPI size 0x63200 — PERIPHERALREGION
0x40B80000 UC2 size 0x80A00 — PERIPHERALREGION
0x40B82000 UC3 size 0x83C00 — PERIPHERALREGION

## Licence text in the file
Copyright (C) 2025 Texas Instruments Incorporated - http://www.ti.com/ Redistribution and use in source and binary forms, with or without modification, are permitted provided that the following conditions are met: Redistributions of source code must retain the above copyright notice, this list of conditions and the following disclaimer. Redistributions in binary form must reproduce the above copyright notice, this list of conditions and the following disclaimer in the documentation and/or other materials provided with the distribution. Neither the name of Texas Instruments Incorporated nor the names of its contributors may be used to endorse or promote products derived from this software without specific prior written permission. THIS SOFTWARE IS PROVIDED BY THE COPYRIGHT HOLDERS AND CONTRIBUTORS "AS IS" AND ANY EXPRESS OR IMPLIED WARRANTIES, INCLUDING, BUT NOT LIMITED TO, THE IMPLIED WARRANTIES OF MERCHANTABILITY AND FITNESS FOR A PARTICULAR PURPOSE ARE DISCLAIMED. IN NO EVENT SHALL THE COPYRIGHT OWNER OR CONTRIBUTORS BE LIABLE FOR ANY DIRECT, INDIRECT, INCIDENTAL, SPECIAL, EXEMPLARY, OR CONSEQUENTIAL DAMAGES (INCLUDING, BUT NOT LIMITED TO, PROCUREMENT OF SUBSTITUTE GOODS OR SERVICES; LOSS OF USE, DATA, OR PROFITS; OR BUSINESS INTERRUPTION) HOWEVER CAUSED AND ON ANY THEORY OF LIABILITY, WHETHER IN CONTRACT, STRICT LIABILITY, OR TORT (INCLUDING NEGLIGENCE OR OTHERWISE) ARISING IN ANY WAY OUT OF THE USE OF THIS SOFTWARE, EVEN IF ADVISED OF THE POSSIBILITY OF SUCH DAMAGE.
